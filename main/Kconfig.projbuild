## sdkconfig.defaults.matter
```kconfig
CONFIG_CONTROL_MATTER_COMMISSIONING_EXPERIMENTAL=y
CONFIG_CONTROL_MATTER_ALLOW_UNTRUSTED_ATTESTATION=y

# The password-entry partial refresh path is disabled for the Matter
# experimental build. On the physical panel it produced overdraw/ghosting in
# the keyboard and password field. Keep the code available, but prefer clean
# full-screen password redraws for this build.
# CONFIG_CONTROL_ENABLE_PARTIAL_REFRESH is not set
# CONFIG_CONTROL_PASSWORD_FIELD_PARTIAL_REFRESH is not set
# CONFIG_CONTROL_PASSWORD_KEYBOARD_PARTIAL_REFRESH is not set

# ESP-Matter controller/commissioner requirements. This project targets
# on-network commissioning first because DIRIGERA is already on the LAN.
# Keep BLE disabled for this experimental build unless a future commissioning
# path explicitly requires it.
# CONFIG_BT_ENABLED is not set
# CONFIG_BT_NIMBLE_ENABLED is not set
# CONFIG_ENABLE_CHIPOBLE is not set
# CONFIG_ENABLE_ESP32_BLE_CONTROLLER is not set
# CONFIG_USE_BLE_ONLY_FOR_COMMISSIONING is not set

CONFIG_ENABLE_CHIP_SHELL=n
CONFIG_ENABLE_CHIP_CONTROLLER_BUILD=y
CONFIG_ESP_MATTER_CONTROLLER_ENABLE=y
CONFIG_ESP_MATTER_COMMISSIONER_ENABLE=y
CONFIG_ESP_MATTER_ENABLE_MATTER_SERVER=n
CONFIG_WIFI_NETWORK_COMMISSIONING_DRIVER=n
CONFIG_MBEDTLS_HKDF_C=y
CONFIG_NUM_UDP_ENDPOINTS=16
CONFIG_ESP_MATTER_MAX_DYNAMIC_ENDPOINT_COUNT=2
CONFIG_ESP_MATTER_MAX_DEVICE_TYPE_COUNT=2
CONFIG_NEWLIB_NANO_FORMAT=y
CONFIG_CHIP_TASK_STACK_SIZE=6144
CONFIG_ESP_MAIN_TASK_STACK_SIZE=8192
CONFIG_ESP_TIMER_TASK_STACK_SIZE=2048
CONFIG_LWIP_HOOK_IP6_ROUTE_DEFAULT=y
CONFIG_LWIP_HOOK_ND6_GET_GW_DEFAULT=y
CONFIG_LWIP_MAX_SOCKETS=16
CONFIG_LWIP_MAX_UDP_PCBS=16
CONFIG_LWIP_UDP_RECVMBOX_SIZE=8
CONFIG_LWIP_TCPIP_RECVMBOX_SIZE=32
CONFIG_LWIP_TCP_RECVMBOX_SIZE=8
CONFIG_LWIP_NETBUF_RECVINFO=y
CONFIG_LWIP_IPV6=y
CONFIG_LWIP_IPV6_AUTOCONFIG=y
CONFIG_LWIP_IPV6_NUM_ADDRESSES=4
CONFIG_LWIP_SNTP_MAX_SERVERS=3
CONFIG_MDNS_MAX_SERVICES=10
CONFIG_MDNS_TASK_STACK_SIZE=4096
CONFIG_CHIP_PROJECT_CONFIG="main/matter_project_config.h"
CONFIG_USE_MINIMAL_MDNS=n

# Matter and application DNS-SD share the ESP-IDF platform mDNS backend.
CONFIG_CONTROL_IKEA_LEGACY_MDNS_DISCOVERY=y

# ESP-Matter RAM/flash optimization guide settings scoped to the Matter build.
CONFIG_EVENT_LOGGING_CRIT_BUFFER_SIZE=256
CONFIG_EVENT_LOGGING_INFO_BUFFER_SIZE=256
CONFIG_EVENT_LOGGING_DEBUG_BUFFER_SIZE=256
CONFIG_MAX_EVENT_QUEUE_SIZE=20
CONFIG_ESP_SYSTEM_EVENT_QUEUE_SIZE=32
CONFIG_ESP_SYSTEM_EVENT_TASK_STACK_SIZE=2048

# Move selected non-critical code out of internal RAM/IRAM for this
# controller build. Keep display-driver waveform/timing code unchanged.
CONFIG_FREERTOS_PLACE_FUNCTIONS_INTO_FLASH=y
CONFIG_RINGBUF_PLACE_FUNCTIONS_INTO_FLASH=y
CONFIG_SPI_FLASH_ROM_IMPL=y
CONFIG_SPI_MASTER_ISR_IN_IRAM=n
CONFIG_SPI_SLAVE_ISR_IN_IRAM=n
CONFIG_HEAP_PLACE_FUNCTION_INTO_FLASH=y

# Controller RAM optimization from the official ESP-Matter controller example.
CONFIG_SPIRAM_MALLOC_ALWAYSINTERNAL=512
CONFIG_SPIRAM_MALLOC_RESERVE_INTERNAL=16384
CONFIG_SPIRAM_ALLOW_BSS_SEG_EXTERNAL_MEMORY=y
CONFIG_SPIRAM_TRY_ALLOCATE_WIFI_LWIP=y
CONFIG_ESP_MATTER_MEM_ALLOC_MODE_EXTERNAL=y
CONFIG_MBEDTLS_EXTERNAL_MEM_ALLOC=y

# Intended unused server-side Matter cluster exclusions. In this controller
# build, ESP-Matter currently resolves SUPPORT_*_CLUSTER symbols back to y;
# verify the generated sdkconfig before counting these as effective.
# CONFIG_SUPPORT_ACCOUNT_LOGIN_CLUSTER is not set
# CONFIG_SUPPORT_ACTIONS_CLUSTER is not set
# CONFIG_SUPPORT_ACTIVATED_CARBON_FILTER_MONITORING_CLUSTER is not set
# CONFIG_SUPPORT_AIR_QUALITY_CLUSTER is not set
# CONFIG_SUPPORT_APPLICATION_BASIC_CLUSTER is not set
# CONFIG_SUPPORT_APPLICATION_LAUNCHER_CLUSTER is not set
# CONFIG_SUPPORT_AUDIO_OUTPUT_CLUSTER is not set
# CONFIG_SUPPORT_BOOLEAN_STATE_CLUSTER is not set
# CONFIG_SUPPORT_BOOLEAN_STATE_CONFIGURATION_CLUSTER is not set
# CONFIG_SUPPORT_CAMERA_AV_SETTINGS_USER_LEVEL_MANAGEMENT_CLUSTER is not set
# CONFIG_SUPPORT_CAMERA_AV_STREAM_MANAGEMENT_CLUSTER is not set
# CONFIG_SUPPORT_CARBON_DIOXIDE_CONCENTRATION_MEASUREMENT_CLUSTER is not set
# CONFIG_SUPPORT_CARBON_MONOXIDE_CONCENTRATION_MEASUREMENT_CLUSTER is not set
# CONFIG_SUPPORT_CHANNEL_CLUSTER is not set
# CONFIG_SUPPORT_CHIME_CLUSTER is not set
# CONFIG_SUPPORT_CLOSURE_CONTROL_CLUSTER is not set
# CONFIG_SUPPORT_CLOSURE_DIMENSION_CLUSTER is not set
# CONFIG_SUPPORT_COMMISSIONER_CONTROL_CLUSTER is not set
# CONFIG_SUPPORT_COMMODITY_METERING_CLUSTER is not set
# CONFIG_SUPPORT_COMMODITY_PRICE_CLUSTER is not set
# CONFIG_SUPPORT_COMMODITY_TARIFF_CLUSTER is not set
# CONFIG_SUPPORT_CONTENT_LAUNCHER_CLUSTER is not set
# CONFIG_SUPPORT_CONTENT_CONTROL_CLUSTER is not set
# CONFIG_SUPPORT_CONTENT_APP_OBSERVER_CLUSTER is not set
# CONFIG_SUPPORT_DEVICE_ENERGY_MANAGEMENT_CLUSTER is not set
# CONFIG_SUPPORT_DEVICE_ENERGY_MANAGEMENT_MODE_CLUSTER is not set
# CONFIG_SUPPORT_DIAGNOSTIC_LOGS_CLUSTER is not set
# CONFIG_SUPPORT_DISHWASHER_ALARM_CLUSTER is not set
# CONFIG_SUPPORT_DISHWASHER_MODE_CLUSTER is not set
# CONFIG_SUPPORT_ELECTRICAL_GRID_CONDITIONS_CLUSTER is not set
# CONFIG_SUPPORT_GROUPCAST_CLUSTER is not set
# CONFIG_SUPPORT_METER_IDENTIFICATION_CLUSTER is not set
# CONFIG_SUPPORT_MICROWAVE_OVEN_MODE_CLUSTER is not set
# CONFIG_SUPPORT_DOOR_LOCK_CLUSTER is not set
# CONFIG_SUPPORT_ECOSYSTEM_INFORMATION_CLUSTER is not set
# CONFIG_SUPPORT_ELECTRICAL_ENERGY_MEASUREMENT_CLUSTER is not set
# CONFIG_SUPPORT_ELECTRICAL_POWER_MEASUREMENT_CLUSTER is not set
# CONFIG_SUPPORT_ENERGY_EVSE_CLUSTER is not set
# CONFIG_SUPPORT_ENERGY_EVSE_MODE_CLUSTER is not set
# CONFIG_SUPPORT_ETHERNET_NETWORK_DIAGNOSTICS_CLUSTER is not set
# CONFIG_SUPPORT_ENERGY_PREFERENCE_CLUSTER is not set
# CONFIG_SUPPORT_FAN_CONTROL_CLUSTER is not set
# CONFIG_SUPPORT_FAULT_INJECTION_CLUSTER is not set
# CONFIG_SUPPORT_FIXED_LABEL_CLUSTER is not set
# CONFIG_SUPPORT_FORMALDEHYDE_CONCENTRATION_MEASUREMENT_CLUSTER is not set
# CONFIG_SUPPORT_HEPA_FILTER_MONITORING_CLUSTER is not set
# CONFIG_SUPPORT_ICD_MANAGEMENT_CLUSTER is not set
# CONFIG_SUPPORT_JOINT_FABRIC_DATASTORE_CLUSTER is not set
# CONFIG_SUPPORT_JOINT_FABRIC_ADMINISTRATOR_CLUSTER is not set
# CONFIG_SUPPORT_KEYPAD_INPUT_CLUSTER is not set
# CONFIG_SUPPORT_LAUNDRY_WASHER_MODE_CLUSTER is not set
# CONFIG_SUPPORT_LOCALIZATION_CONFIGURATION_CLUSTER is not set
# CONFIG_SUPPORT_LOW_POWER_CLUSTER is not set
# CONFIG_SUPPORT_MEDIA_INPUT_CLUSTER is not set
# CONFIG_SUPPORT_MEDIA_PLAYBACK_CLUSTER is not set
# CONFIG_SUPPORT_MICROWAVE_OVEN_CONTROL_CLUSTER is not set
# CONFIG_SUPPORT_MESSAGES_CLUSTER is not set
# CONFIG_SUPPORT_MODE_SELECT_CLUSTER is not set
# CONFIG_SUPPORT_NITROGEN_DIOXIDE_CONCENTRATION_MEASUREMENT_CLUSTER is not set
# CONFIG_SUPPORT_PUSH_AV_STREAM_TRANSPORT_CLUSTER is not set
# CONFIG_SUPPORT_SAMPLE_MEI_CLUSTER is not set
# CONFIG_SUPPORT_OCCUPANCY_SENSING_CLUSTER is not set
# CONFIG_SUPPORT_POWER_TOPOLOGY_CLUSTER is not set
# CONFIG_SUPPORT_OPERATIONAL_STATE_CLUSTER is not set
# CONFIG_SUPPORT_OPERATIONAL_STATE_OVEN_CLUSTER is not set
# CONFIG_SUPPORT_OPERATIONAL_STATE_RVC_CLUSTER is not set
# CONFIG_SUPPORT_OTA_SOFTWARE_UPDATE_PROVIDER_CLUSTER is not set
# CONFIG_SUPPORT_OTA_SOFTWARE_UPDATE_REQUESTOR_CLUSTER is not set
# CONFIG_SUPPORT_OVEN_MODE_CLUSTER is not set
# CONFIG_SUPPORT_OZONE_CONCENTRATION_MEASUREMENT_CLUSTER is not set
# CONFIG_SUPPORT_PM10_CONCENTRATION_MEASUREMENT_CLUSTER is not set
# CONFIG_SUPPORT_PM1_CONCENTRATION_MEASUREMENT_CLUSTER is not set
# CONFIG_SUPPORT_PM2_5_CONCENTRATION_MEASUREMENT_CLUSTER is not set
# CONFIG_SUPPORT_POWER_SOURCE_CLUSTER is not set
# CONFIG_SUPPORT_POWER_SOURCE_CONFIGURATION_CLUSTER is not set
# CONFIG_SUPPORT_PUMP_CONFIGURATION_AND_CONTROL_CLUSTER is not set
# CONFIG_SUPPORT_RADON_CONCENTRATION_MEASUREMENT_CLUSTER is not set
# CONFIG_SUPPORT_REFRIGERATOR_ALARM_CLUSTER is not set
# CONFIG_SUPPORT_REFRIGERATOR_AND_TEMPERATURE_CONTROLLED_CABINET_MODE_CLUSTER is not set
# CONFIG_SUPPORT_RVC_CLEAN_MODE_CLUSTER is not set
# CONFIG_SUPPORT_RVC_RUN_MODE_CLUSTER is not set
# CONFIG_SUPPORT_SERVICE_AREA_CLUSTER is not set
# CONFIG_SUPPORT_SMOKE_CO_ALARM_CLUSTER is not set
# CONFIG_SUPPORT_SOFTWARE_DIAGNOSTICS_CLUSTER is not set
# CONFIG_SUPPORT_SOIL_MEASUREMENT_CLUSTER is not set
# CONFIG_SUPPORT_TARGET_NAVIGATOR_CLUSTER is not set
# CONFIG_SUPPORT_TEMPERATURE_CONTROL_CLUSTER is not set
# CONFIG_SUPPORT_THERMOSTAT_CLUSTER is not set
# CONFIG_SUPPORT_THERMOSTAT_USER_INTERFACE_CONFIGURATION_CLUSTER is not set
# CONFIG_SUPPORT_THREAD_BORDER_ROUTER_MANAGEMENT_CLUSTER is not set
# CONFIG_SUPPORT_THREAD_NETWORK_DIAGNOSTICS_CLUSTER is not set
# CONFIG_SUPPORT_THREAD_NETWORK_DIRECTORY_CLUSTER is not set
# CONFIG_SUPPORT_TIME_FORMAT_LOCALIZATION_CLUSTER is not set
# CONFIG_SUPPORT_TIME_SYNCHRONIZATION_CLUSTER is not set
# CONFIG_SUPPORT_TIMER_CLUSTER is not set
# CONFIG_SUPPORT_TLS_CERTIFICATE_MANAGEMENT_CLUSTER is not set
# CONFIG_SUPPORT_TLS_CLIENT_MANAGEMENT_CLUSTER is not set
# CONFIG_SUPPORT_TVOC_CONCENTRATION_MEASUREMENT_CLUSTER is not set
# CONFIG_SUPPORT_UNIT_LOCALIZATION_CLUSTER is not set
# CONFIG_SUPPORT_UNIT_TESTING_CLUSTER is not set
# CONFIG_SUPPORT_USER_LABEL_CLUSTER is not set
# CONFIG_SUPPORT_VALVE_CONFIGURATION_AND_CONTROL_CLUSTER is not set
# CONFIG_SUPPORT_WAKE_ON_LAN_CLUSTER is not set
# CONFIG_SUPPORT_LAUNDRY_WASHER_CONTROLS_CLUSTER is not set
# CONFIG_SUPPORT_LAUNDRY_DRYER_CONTROLS_CLUSTER is not set
# CONFIG_SUPPORT_WEB_RTC_TRANSPORT_PROVIDER_CLUSTER is not set
# CONFIG_SUPPORT_WEB_RTC_TRANSPORT_REQUESTOR_CLUSTER is not set
# CONFIG_SUPPORT_WIFI_NETWORK_MANAGEMENT_CLUSTER is not set
# CONFIG_SUPPORT_WINDOW_COVERING_CLUSTER is not set
# CONFIG_SUPPORT_WATER_HEATER_MANAGEMENT_CLUSTER is not set
# CONFIG_SUPPORT_WATER_HEATER_MODE_CLUSTER is not set
# CONFIG_SUPPORT_ZONE_MANAGEMENT_CLUSTER is not set

# Use conservative Wi-Fi buffers for runtime stability. The Matter build still
# keeps safe Matter-side optimizations, but avoids starving the Wi-Fi driver.
CONFIG_ESP_WIFI_STATIC_RX_BUFFER_NUM=10
CONFIG_ESP_WIFI_DYNAMIC_RX_BUFFER_NUM=32
CONFIG_ESP_WIFI_DYNAMIC_TX_BUFFER_NUM=32
CONFIG_ESP_WIFI_MGMT_SBUF_NUM=32
# CONFIG_ESP_WIFI_AMPDU_TX_ENABLED is not set
# CONFIG_ESP_WIFI_AMPDU_RX_ENABLED is not set

# Keep current hardware flash size; partition size will be validated by build.
CONFIG_ESPTOOLPY_FLASHSIZE_16MB=y

# Matter controller builds need substantially more app and NVS space than the
# safe hardware-validation build. Keep this partition table scoped to builds
# that include sdkconfig.defaults.matter.
# CONFIG_PARTITION_TABLE_SINGLE_APP_LARGE is not set
CONFIG_PARTITION_TABLE_CUSTOM=y
CONFIG_PARTITION_TABLE_CUSTOM_FILENAME="partitions_matter.csv"
CONFIG_PARTITION_TABLE_FILENAME="partitions_matter.csv"
CONFIG_PARTITION_TABLE_OFFSET=0x8000
```

## sdkconfig.defaults.matter_stable
```kconfig
# Conservative Matter build layered on the validated recovery baseline.

CONFIG_CONTROL_RECOVERY_BUILD=n
CONFIG_CONTROL_MATTER_CONTROLLER=y
CONFIG_CONTROL_MATTER_COMMISSIONING=y
CONFIG_CONTROL_MATTER_COMMISSIONING_EXPERIMENTAL=y
CONFIG_CONTROL_MATTER_ALLOW_UNTRUSTED_ATTESTATION=y

# ESP-Matter controller/commissioner integration.
CONFIG_ENABLE_CHIP_SHELL=n
CONFIG_ENABLE_CHIP_CONTROLLER_BUILD=y
CONFIG_ESP_MATTER_CONTROLLER_ENABLE=y
CONFIG_ESP_MATTER_COMMISSIONER_ENABLE=y
CONFIG_ESP_MATTER_ENABLE_MATTER_SERVER=n
CONFIG_WIFI_NETWORK_COMMISSIONING_DRIVER=n
CONFIG_MBEDTLS_HKDF_C=y
CONFIG_NUM_UDP_ENDPOINTS=16
CONFIG_ESP_MATTER_MAX_DYNAMIC_ENDPOINT_COUNT=2
CONFIG_ESP_MATTER_MAX_DEVICE_TYPE_COUNT=2
CONFIG_CHIP_TASK_STACK_SIZE=24576
CONFIG_CHIP_PROJECT_CONFIG="main/matter_project_config.h"

# Matter commissionable discovery uses CHIP Minimal mDNS.
CONFIG_USE_MINIMAL_MDNS=y
CONFIG_CONTROL_UI_DASHBOARD_V1=y
CONFIG_CONTROL_UI_MATTER_COMMANDS=y

# On-network commissioning does not use the Bluetooth controller.
# CONFIG_BT_ENABLED is not set
# CONFIG_BT_NIMBLE_ENABLED is not set
# CONFIG_ENABLE_CHIPOBLE is not set
# CONFIG_ENABLE_ESP32_BLE_CONTROLLER is not set
# CONFIG_USE_BLE_ONLY_FOR_COMMISSIONING is not set

# Preserve the validated recovery runtime settings.
CONFIG_ESP_MAIN_TASK_STACK_SIZE=24576
CONFIG_ESP_TIMER_TASK_STACK_SIZE=4096
# CONFIG_NEWLIB_NANO_FORMAT is not set
# CONFIG_NVS_ALLOCATE_CACHE_IN_SPIRAM is not set
# CONFIG_SPIRAM_ALLOW_BSS_SEG_EXTERNAL_MEMORY is not set
# CONFIG_SPIRAM_ALLOW_NOINIT_SEG_EXTERNAL_MEMORY is not set
# CONFIG_SPIRAM_TRY_ALLOCATE_WIFI_LWIP is not set
# CONFIG_FREERTOS_TASK_CREATE_ALLOW_EXT_MEM is not set
# CONFIG_FREERTOS_PLACE_FUNCTIONS_INTO_FLASH is not set
# CONFIG_RINGBUF_PLACE_FUNCTIONS_INTO_FLASH is not set
# CONFIG_HEAP_PLACE_FUNCTION_INTO_FLASH is not set

# Matter application layout.
CONFIG_PARTITION_TABLE_CUSTOM=y
CONFIG_PARTITION_TABLE_CUSTOM_FILENAME="partitions_matter.csv"
CONFIG_PARTITION_TABLE_FILENAME="partitions_matter.csv"
CONFIG_PARTITION_TABLE_OFFSET=0x8000
```
