## main/Kconfig.projbuild
```kconfig
menu "Control diagnostics"

config CONTROL_RECOVERY_BUILD
    bool "Build conservative recovery firmware"
    default n
    help
        Restricts startup to NVS, display, touch, Wi-Fi, and the setup UI.
        Matter, IKEA discovery, mDNS, and early network workers remain
        disabled until the base firmware is stable.

config CONTROL_IKEA_DISCOVERY
    bool "Enable IKEA/DIRIGERA local network discovery"
    default y
    help
        Enables the bounded local-network discovery worker used after Wi-Fi
        connection. This does not implement Matter commissioning.

config CONTROL_IKEA_LEGACY_MDNS_DISCOVERY
    bool "Enable legacy IKEA/DIRIGERA mDNS and DNS-SD discovery"
    depends on CONTROL_IKEA_DISCOVERY
    default y
    help
        Enables IKEA/DIRIGERA DNS-SD browsing through the shared ESP-IDF mDNS
        backend. Matter builds must use CONFIG_USE_MINIMAL_MDNS=n.

config CONTROL_IKEA_HOSTNAME_FALLBACK
    bool "Enable IKEA/DIRIGERA hostname fallback"
    depends on CONTROL_IKEA_DISCOVERY
    default y
    help
        Attempts conservative hostname resolution for known DIRIGERA name
        variants after DNS-SD browsing.

config CONTROL_IKEA_IP_DIAGNOSTICS
    bool "Enable IKEA/DIRIGERA IP diagnostics"
    depends on CONTROL_IKEA_DISCOVERY
    default y
    help
        Logs local IP, gateway, netmask, DNS, RSSI, and MAC information before
        discovery so router and subnet issues can be diagnosed.

config CONTROL_IKEA_KNOWN_IP
    string "Known IKEA/DIRIGERA diagnostic IP"
    depends on CONTROL_IKEA_DISCOVERY
    default "192.168.50.116"
    help
        Optional known IP to probe during IKEA discovery. A reachable IP is
        classified as unconfirmed unless mDNS/DNS-SD or hostname data clearly
        identifies IKEA, DIRIGERA, or hubv3.

config CONTROL_NET_DIAG_PING_SWEEP
    bool "Enable diagnostic LAN ping sweep"
    depends on CONTROL_IKEA_DISCOVERY
    default n
    help
        Development-only network diagnostic for future use. When enabled, the
        discovery worker may scan a /24 subnet with short ping timeouts, but
        ping reachability alone must never classify a host as IKEA.

config CONTROL_MATTER_CONTROLLER
    bool "Enable Control Matter controller abstraction"
    default y
    help
        Builds the Control-side Matter controller interface and UI flow. This
        option alone does not link ESP-Matter and does not run commissioning.

config CONTROL_MATTER_COMMISSIONING
    bool "Enable Matter commissioning UI flow"
    depends on CONTROL_MATTER_CONTROLLER
    default y
    help
        Enables screens and state transitions that prepare a manual Matter code
        for commissioning. Real commissioning remains blocked unless the
        experimental commissioning option is also enabled and ESP-Matter is
        integrated.

config CONTROL_MATTER_COMMISSIONING_EXPERIMENTAL
    bool "Enable experimental real ESP-Matter commissioning"
    depends on CONTROL_MATTER_COMMISSIONING
    default n
    help
        Development-only gate for real ESP-Matter controller/commissioner
        integration. When disabled, pressing Continue after a valid Matter code
        shows a clear placeholder and no Matter stack action is attempted.

config CONTROL_MATTER_ALLOW_UNTRUSTED_ATTESTATION
    bool "Allow untrusted Matter device attestation"
    depends on CONTROL_MATTER_COMMISSIONING_EXPERIMENTAL
    default n
    help
        Development only. Allows commissioning even when device attestation
        cannot be verified due to missing PAA trust store / DCL. Do not use
        for production.

config CONTROL_TOUCH_UI_DISPATCH
    bool "Enable minimal touch-driven UI dispatch"
    default y
    help
        Enables PRESS-only dispatch from the GT911 event queue to the UI hit
        tester. MOVE and RELEASE never request screen redraws. Display refreshes
        remain owned by the app/UI loop and occur only on explicit state changes.

config CONTROL_UI_DASHBOARD_V1
    bool "Enable local mock home dashboard UI v1"
    default n
    help
        Enables the isolated home dashboard with home, rooms, and room-detail
        screens. It does not replace the existing commissioning UI.

config CONTROL_UI_MATTER_COMMANDS
    bool "Connect dashboard light controls to Matter OnOff"
    depends on CONTROL_UI_DASHBOARD_V1 && CONTROL_MATTER_CONTROLLER
    default n
    help
        Queues dashboard light actions for the existing Matter controller.
        Endpoints are bound only from the discovered device cache when the
        configured room/device name match is unambiguous and OnOff is present.

config CONTROL_UI_DEVICE_ONBOARDING
    bool "Enable Matter device onboarding and room binding"
    depends on CONTROL_UI_DASHBOARD_V1 && CONTROL_MATTER_CONTROLLER
    default n
    help
        Discovers real Matter endpoints, assigns them to rooms, and stores the
        UI bindings in the separate control_ui NVS namespace.

config CONTROL_UI_MOCK_DEVICES
    bool "Enable dashboard mock devices"
    depends on CONTROL_UI_DASHBOARD_V1
    default n
    help
        Development-only dashboard fixtures. Matter stable builds keep this
        disabled so missing bindings never look like real devices.

config CONTROL_WEB_SERIAL_CONFIGURATOR
    bool "Enable the USB and authenticated Wi-Fi configurator"
    depends on CONTROL_UI_MATTER_COMMANDS
    default n
    help
        Enables the local @@CFG JSON protocol on the existing serial console.
        Also serves the configurator over HTTP on the local Wi-Fi network,
        protected by a per-device access code shown in Configuration.
        It never exposes raw Matter or NVS access.

config CONTROL_TOUCH_DEBUG
    bool "Verbose touch movement diagnostics"
    default y
    help
        Log meaningful GT911 MOVE events in addition to PRESS and RELEASE.
        Idle polling is never logged.

config CONTROL_TOUCH_TASK_STACK_SIZE
    int "Control touch task stack size (bytes)"
    default 4096
    range 3072 8192
    help
        Stack reserved for GT911 polling and I2C reads. Units are bytes.

config CONTROL_ENABLE_PARTIAL_REFRESH
    bool "Enable experimental partial e-paper refresh"
    default n
    help
        Disabled by default: the panel can retain ghost images or be damaged
        by repeated partial refreshes. Full-screen refresh is the safe path.

config CONTROL_PASSWORD_FIELD_PARTIAL_REFRESH
    bool "Use partial refresh for Wi-Fi password field"
    depends on CONTROL_ENABLE_PARTIAL_REFRESH
    default y
    help
        Updates only the password field rectangle while typing. If disabled or
        if the partial refresh fails, key presses update the internal password
        buffer without triggering a full-screen refresh.

config CONTROL_PASSWORD_KEYBOARD_PARTIAL_REFRESH
    bool "Use partial refresh for Wi-Fi password keyboard"
    depends on CONTROL_ENABLE_PARTIAL_REFRESH
    default y
    help
        Updates only the keyboard rectangle when switching lowercase,
        uppercase, and symbol keyboard layouts. If disabled or unsupported,
        keyboard mode changes update internal state only and do not trigger a
        full-screen refresh per mode change.

config CONTROL_PASSWORD_REFRESH_EVERY_N_KEYS
    int "Password field refresh interval in key presses"
    depends on CONTROL_PASSWORD_FIELD_PARTIAL_REFRESH
    default 1
    range 1 8
    help
        Number of normal character key presses to batch before refreshing the
        password field region. Backspace and clear force an immediate field
        refresh.

config CONTROL_PASSWORD_PARTIALS_BEFORE_FULL_REFRESH
    int "Password partial refreshes before a full password-screen cleanup"
    depends on CONTROL_PASSWORD_FIELD_PARTIAL_REFRESH
    default 20
    range 1 100
    help
        Number of successful password-field partial refreshes before scheduling
        one full refresh of the password screen to limit ghosting. The cleanup
        full refresh is only performed while the password screen is still active.

endmenu
```

## sdkconfig.defaults
```kconfig
CONFIG_IDF_TARGET="esp32s3"
CONFIG_ESPTOOLPY_FLASHSIZE_16MB=y
CONFIG_ESPTOOLPY_FLASHMODE_QIO=y
CONFIG_ESPTOOLPY_FLASHFREQ_80M=y
CONFIG_SPIRAM=y
CONFIG_SPIRAM_MODE_OCT=y
CONFIG_SPIRAM_SPEED_80M=y
CONFIG_SPIRAM_USE_MALLOC=y
CONFIG_SPIRAM_MALLOC_ALWAYSINTERNAL=16384
CONFIG_ESP_CONSOLE_USB_CDC=y
CONFIG_ESP_CONSOLE_UART_BAUDRATE=115200
CONFIG_LOG_DEFAULT_LEVEL_INFO=y
CONFIG_LWIP_SNTP_MAX_SERVERS=3
CONFIG_CONTROL_IKEA_DISCOVERY=y
CONFIG_CONTROL_IKEA_LEGACY_MDNS_DISCOVERY=y
CONFIG_CONTROL_IKEA_HOSTNAME_FALLBACK=y
CONFIG_CONTROL_IKEA_IP_DIAGNOSTICS=y
CONFIG_CONTROL_IKEA_KNOWN_IP="192.168.50.116"
# CONFIG_CONTROL_NET_DIAG_PING_SWEEP is not set
CONFIG_CONTROL_MATTER_CONTROLLER=y
CONFIG_CONTROL_MATTER_COMMISSIONING=y
# CONFIG_CONTROL_MATTER_COMMISSIONING_EXPERIMENTAL is not set
# CONFIG_CONTROL_MATTER_ALLOW_UNTRUSTED_ATTESTATION is not set
CONFIG_CONTROL_TOUCH_UI_DISPATCH=y
CONFIG_CONTROL_TOUCH_DEBUG=y
CONFIG_CONTROL_TOUCH_TASK_STACK_SIZE=4096
# Password/Matter input screens must not use automatic partial refresh by
# default. Region refresh on the physical e-paper panel produced overdraw and
# unusable input. Keep the code available for future experiments only.
# CONFIG_CONTROL_ENABLE_PARTIAL_REFRESH is not set
# CONFIG_CONTROL_PASSWORD_FIELD_PARTIAL_REFRESH is not set
# CONFIG_CONTROL_PASSWORD_KEYBOARD_PARTIAL_REFRESH is not set
CONFIG_CONTROL_PASSWORD_PARTIALS_BEFORE_FULL_REFRESH=20
CONFIG_ESP_MAIN_TASK_STACK_SIZE=16384
CONFIG_FREERTOS_WATCHPOINT_END_OF_STACK=y
CONFIG_PARTITION_TABLE_SINGLE_APP_LARGE=y
CONFIG_COMPILER_CXX_EXCEPTIONS=n
CONFIG_COMPILER_CXX_RTTI=n
```
